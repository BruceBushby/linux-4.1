## drivers/aerex/Kconfig
```kconfig
#
# Misc strange devices
#

menu "Aerex Drone"

source "drivers/aerex/bosch/Kconfig"
source "drivers/aerex/meas-spec/Kconfig"
source "drivers/aerex/servodrive/Kconfig"

endmenu
```

## drivers/aerex/meas-spec/Kconfig
```kconfig
#
# Misc strange devices
#
config SENSORS_MS5637
	tristate "Measurement Specialties MS5637 pressure sensors"
	depends on I2C
	help
	  If you say yes here you get support for the Measurement Specialties
	  MS5637 pressure sensors.

	  This driver can also be built as a module.  If so, the module
	  will be called ms5637.

config SENSORS_MS5611
	tristate "Measurement Specialties MS5611 pressure sensors"
	depends on SPI_MASTER && SYSFS
	help
	  If you say yes here you get support for the Measurement Specialties
	  MS5611 pressure sensors.

	  This driver can also be built as a module.  If so, the module
	  will be called ms5611.
```

## drivers/aerex/servodrive/Kconfig
```kconfig
#
# Misc strange devices
#
config SERVODRIVE
	tristate "Eable PWM Servo Control via GPIO pins"
	help
	The driver implements pulse width modulation (PWM) by pulsing the 
	gpio signals which are connected to the signaling wire of a standard 
	RC servo. Any pin on the expansion header may be used to generate the
	PWM signal provided the MUX has been properly configured in u-boot
	or linux kernel. If you do not want to change the MUX configuration,
	as a starting point you can try the following pins which are confirmed
	to work with standard angstrom demo image and u-boot:
```
